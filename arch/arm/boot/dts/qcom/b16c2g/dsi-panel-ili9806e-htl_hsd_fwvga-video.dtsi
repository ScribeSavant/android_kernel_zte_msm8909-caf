/* Copyright (c) 2014-2015, The Linux Foundation. All rights reserved.
 *
 * This program is free software; you can redistribute it and/or modify
 * it under the terms of the GNU General Public License version 2 and
 * only version 2 as published by the Free Software Foundation.
 *
 * This program is distributed in the hope that it will be useful,
 * but WITHOUT ANY WARRANTY; without even the implied warranty of
 * MERCHANTABILITY or FITNESS FOR A PARTICULAR PURPOSE.  See the
 * GNU General Public License for more details.
 */

/*---------------------------------------------------------------------------
 * This file is autogenerated file using gcdb parser. Please do not edit it.
 * Update input XML file to add a new entry or update variable in this file
 * VERSION = "1.0"
 *---------------------------------------------------------------------------*/
&mdss_mdp {
	dsi_ili9806e_hlt_hsd_fwvga_video: qcom,mdss_dsi_ili9806e_hlt_hsd_fwvga_video {
		qcom,mdss-dsi-panel-name = "hlt_hsd ili9806e fwvga";
		qcom,mdss-dsi-panel-controller = <&mdss_dsi0>;
		qcom,mdss-dsi-panel-type = "dsi_video_mode";
		qcom,mdss-dsi-panel-destination = "display_1";
		qcom,mdss-dsi-panel-framerate = <0x3c>;
		qcom,mdss-dsi-virtual-channel-id = <0x0>;
		qcom,mdss-dsi-stream = <0x0>;
		qcom,mdss-dsi-panel-width = <0x1e0>;
		qcom,mdss-dsi-panel-height = <0x356>;
		qcom,mdss-pan-physical-width-dimension = <0x37>;
		qcom,mdss-pan-physical-height-dimension = <0x63>;
		qcom,mdss-dsi-h-front-porch = <0x50>;
		qcom,mdss-dsi-h-back-porch = <0x64>;
		qcom,mdss-dsi-h-pulse-width = <0xa>;
		qcom,mdss-dsi-h-sync-skew = <0x0>;
		qcom,mdss-dsi-v-front-porch = <0x14>;
		qcom,mdss-dsi-v-back-porch = <0x10>;
		qcom,mdss-dsi-v-pulse-width = <0x4>;
		qcom,mdss-dsi-h-left-border = <0x0>;
		qcom,mdss-dsi-h-right-border = <0x0>;
		qcom,mdss-dsi-v-top-border = <0x0>;
		qcom,mdss-dsi-v-bottom-border = <0x0>;
		qcom,mdss-dsi-bpp = <0x18>;
		qcom,mdss-dsi-color-order = <0x0>;
		qcom,mdss-dsi-underflow-color = <0xff>;
		qcom,mdss-dsi-border-color = <0x0>;
		qcom,mdss-dsi-on-command = <0x29010000 0x6ff 0xff980604 0x1150100 0x2 0x8101501 0x0 0x2210115 0x1000000 0x23001 0x15010000 0x231 0x2150100 0x2 0x40141501 0x0 0x2413315 0x1000000 0x24203 0x15010000 0x243 0x9150100 0x2 0x44071501 0x0 0x2451615 0x1000000 0x25080 0x15010000 0x251 0x80150100 0x2 0x52001501 0x0 0x2534715 0x1000000 0x2600a 0x15010000 0x261 0x150100 0x2 0x62081501 0x0 0x2630015 0x1000000 0x2a000 0x15010000 0x2a1 0xb150100 0x2 0xa2161501 0x0 0x2a30f15 0x1000000 0x2a408 0x15010000 0x2a5 0x17150100 0x2 0xa6091501 0x0 0x2a70715 0x1000000 0x2a803 0x15010000 0x2a9 0x9150100 0x2 0xaa061501 0x0 0x2ab0a15 0x1000000 0x2ac0f 0x15010000 0x2ad 0x30150100 0x2 0xae2c1501 0x0 0x2af0015 0x1000000 0x2c000 0x15010000 0x2c1 0x8150100 0x2 0xc2121501 0x0 0x2c31015 0x1000000 0x2c409 0x15010000 0x2c5 0x13150100 0x2 0xc60a1501 0x0 0x2c70715 0x1000000 0x2c805 0x15010000 0x2c9 0xa150100 0x2 0xca081501 0x0 0x2cb0515 0x1000000 0x2cc0b 0x15010000 0x2cd 0x26150100 0x2 0xce211501 0x0 0x2cf0029 0x1000000 0x6ffff 0x98060406 0x15010000 0x200 0x21150100 0x2 0x10a1501 0x0 0x2020015 0x1000000 0x20300 0x15010000 0x204 0x1150100 0x2 0x5011501 0x0 0x2068015 0x1000000 0x20706 0x15010000 0x208 0x4150100 0x2 0x9801501 0x0 0x20a0015 0x1000000 0x20b00 0x15010000 0x20c 0xa150100 0x2 0xd0a1501 0x0 0x20e0015 0x1000000 0x20f00 0x15010000 0x210 0xf0150100 0x2 0x11f41501 0x0 0x2120415 0x1000000 0x21300 0x15010000 0x214 0x150100 0x2 0x15c01501 0x0 0x2160815 0x1000000 0x21700 0x15010000 0x218 0x150100 0x2 0x19001501 0x0 0x21a0015 0x1000000 0x21b00 0x15010000 0x21c 0x150100 0x2 0x1d001501 0x0 0x2200115 0x1000000 0x22123 0x15010000 0x222 0x45150100 0x2 0x23671501 0x0 0x2240115 0x1000000 0x22523 0x15010000 0x226 0x45150100 0x2 0x27671501 0x0 0x2300115 0x1000000 0x23111 0x15010000 0x232 0x150100 0x2 0x33ee1501 0x0 0x234ff15 0x1000000 0x235bb 0x15010000 0x236 0xaa150100 0x2 0x37dd1501 0x0 0x238cc15 0x1000000 0x23976 0x15010000 0x23a 0x67150100 0x2 0x3b221501 0x0 0x23c2215 0x1000000 0x23d22 0x15010000 0x23e 0x22150100 0x2 0x3f221501 0x0 0x2402215 0x1000000 0x25210 0x15010000 0x253 0x10150100 0x2 0x58972901 0x0 0x6ffff98 0x6040715 0x1000000 0x2181d 0x15010000 0x217 0x22150100 0x2 0x2771501 0x0 0x226b215 0x1000000 0x2e179 0x15010000 0x206 0x13290100 0x6 0xffff9806 0x4000501 0x7800 0x2110005 0x1000014 0x22900>;
		qcom,mdss-dsi-off-command = [05 01 00 00 32 00 02 28 00 05 01 00 00 78 00 02 10 00];
		qcom,mdss-dsi-on-command-state = "dsi_lp_mode";
		qcom,mdss-dsi-off-command-state = "dsi_lp_mode";
		qcom,mdss-dsi-h-sync-pulse = <0x1>;
		qcom,mdss-dsi-traffic-mode = "burst_mode";
		qcom,mdss-dsi-lane-map = "lane_map_3012";
		qcom,mdss-dsi-bllp-eof-power-mode;
		qcom,mdss-dsi-bllp-power-mode;
		qcom,mdss-dsi-lane-0-state;
		qcom,mdss-dsi-lane-1-state;
		qcom,mdss-dsi-panel-timings = <0x7a1a1200 0x4042161e 0x14030400>;
		qcom,mdss-dsi-t-clk-post = <0x4>;
		qcom,mdss-dsi-t-clk-pre = <0x1a>;
		qcom,mdss-dsi-dma-trigger = "trigger_sw";
		qcom,mdss-dsi-mdp-trigger = "none";
		qcom,mdss-dsi-reset-sequence = <0x1 0xa 0x0 0xa 0x1 0x14>;
		qcom,mdss-dsi-lp11-init;
		qcom,mdss-dsi-bl-delay-ms = <0x1e>;
		qcom,cont-splash-enabled;
	};
};
