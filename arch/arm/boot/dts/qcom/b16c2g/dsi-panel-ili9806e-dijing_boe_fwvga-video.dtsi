/* Copyright (c) 2014-2015, The Linux Foundation. All rights reserved.
 *
 * This program is free software; you can redistribute it and/or modify
 * it under the terms of the GNU General Public License version 2 and
 * only version 2 as published by the Free Software Foundation.
 *
 * This program is distributed in the hope that it will be useful,
 * but WITHOUT ANY WARRANTY; without even the implied warranty of
 * MERCHANTABILITY or FITNESS FOR A PARTICULAR PURPOSE.  See the
 * GNU General Public License for more details.
 */

/*---------------------------------------------------------------------------
 * This file is autogenerated file using gcdb parser. Please do not edit it.
 * Update input XML file to add a new entry or update variable in this file
 * VERSION = "1.0"
 *---------------------------------------------------------------------------*/
&mdss_mdp {
	dsi_ili9806e_dijing_boe_fwvga_video: qcom,mdss_dsi_ili9806e_dijing_boe_fwvga_video {
		qcom,mdss-dsi-panel-name = "dijing_boe ili9806e fwvga";
		qcom,mdss-dsi-panel-controller = <&mdss_dsi0>;
		qcom,mdss-dsi-panel-type = "dsi_video_mode";
		qcom,mdss-dsi-panel-destination = "display_1";
		qcom,mdss-dsi-panel-framerate = <0x3c>;
		qcom,mdss-dsi-virtual-channel-id = <0x0>;
		qcom,mdss-dsi-stream = <0x0>;
		qcom,mdss-dsi-panel-width = <0x1e0>;
		qcom,mdss-dsi-panel-height = <0x356>;
		qcom,mdss-pan-physical-width-dimension = <0x37>;
		qcom,mdss-pan-physical-height-dimension = <0x63>;
		qcom,mdss-dsi-h-front-porch = <0x50>;
		qcom,mdss-dsi-h-back-porch = <0x3c>;
		qcom,mdss-dsi-h-pulse-width = <0xa>;
		qcom,mdss-dsi-h-sync-skew = <0x0>;
		qcom,mdss-dsi-v-front-porch = <0x18>;
		qcom,mdss-dsi-v-back-porch = <0x14>;
		qcom,mdss-dsi-v-pulse-width = <0x4>;
		qcom,mdss-dsi-h-left-border = <0x0>;
		qcom,mdss-dsi-h-right-border = <0x0>;
		qcom,mdss-dsi-v-top-border = <0x0>;
		qcom,mdss-dsi-v-bottom-border = <0x0>;
		qcom,mdss-dsi-bpp = <0x18>;
		qcom,mdss-dsi-color-order = <0x0>;
		qcom,mdss-dsi-underflow-color = <0xff>;
		qcom,mdss-dsi-border-color = <0x0>;
		qcom,mdss-dsi-on-command = [29 01 00 00 00 00 06 ff ff 98 06 04 01 15 01 00 00 00 00 02 08 10 15 01 00 00 00 00 02 21 01 15 01 00 00 00 00 02 30 01 15 01 00 00 00 00 02 31 02 15 01 00 00 00 00 02 60 07 15 01 00 00 00 00 02 61 06 15 01 00 00 00 00 02 62 06 15 01 00 00 00 00 02 63 04 15 01 00 00 00 00 02 40 16 15 01 00 00 00 00 02 41 33 15 01 00 00 00 00 02 42 02 15 01 00 00 00 00 02 43 09 15 01 00 00 00 00 02 44 0c 15 01 00 00 00 00 02 50 60 15 01 00 00 00 00 02 51 60 15 01 00 00 00 00 02 52 00 15 01 00 00 00 00 02 53 43 15 01 00 00 00 00 02 57 50 15 01 00 00 00 00 02 a0 00 15 01 00 00 00 00 02 a1 08 15 01 00 00 00 00 02 a2 07 15 01 00 00 00 00 02 a3 0c 15 01 00 00 00 00 02 a4 04 15 01 00 00 00 00 02 a5 09 15 01 00 00 00 00 02 a6 07 15 01 00 00 00 00 02 a7 06 15 01 00 00 00 00 02 a8 07 15 01 00 00 00 00 02 a9 08 15 01 00 00 00 00 02 aa 12 15 01 00 00 00 00 02 ab 08 15 01 00 00 00 00 02 ac 0f 15 01 00 00 00 00 02 ad 1d 15 01 00 00 00 00 02 ae 16 15 01 00 00 00 00 02 af 00 15 01 00 00 00 00 02 c0 00 15 01 00 00 00 00 02 c1 05 15 01 00 00 00 00 02 c2 10 15 01 00 00 00 00 02 c3 0a 15 01 00 00 00 00 02 c4 03 15 01 00 00 00 00 02 c5 08 15 01 00 00 00 00 02 c6 07 15 01 00 00 00 00 02 c7 04 15 01 00 00 00 00 02 c8 07 15 01 00 00 00 00 02 c9 0d 15 01 00 00 00 00 02 ca 10 15 01 00 00 00 00 02 cb 08 15 01 00 00 00 00 02 cc 0e 15 01 00 00 00 00 02 cd 1c 15 01 00 00 00 00 02 ce 10 15 01 00 00 00 00 02 cf 00 29 01 00 00 00 00 06 ff ff 98 06 04 06 15 01 00 00 00 00 02 00 21 15 01 00 00 00 00 02 01 05 15 01 00 00 00 00 02 02 00 15 01 00 00 00 00 02 03 00 15 01 00 00 00 00 02 04 01 15 01 00 00 00 00 02 05 01 15 01 00 00 00 00 02 06 80 15 01 00 00 00 00 02 07 04 15 01 00 00 00 00 02 08 03 15 01 00 00 00 00 02 09 00 15 01 00 00 00 00 02 0a 00 15 01 00 00 00 00 02 0b 00 15 01 00 00 00 00 02 0c 01 15 01 00 00 00 00 02 0d 01 15 01 00 00 00 00 02 0e 00 15 01 00 00 00 00 02 0f 00 15 01 00 00 00 00 02 10 50 15 01 00 00 00 00 02 11 50 15 01 00 00 00 00 02 12 00 15 01 00 00 00 00 02 13 00 15 01 00 00 00 00 02 14 00 15 01 00 00 00 00 02 15 c0 15 01 00 00 00 00 02 16 08 15 01 00 00 00 00 02 17 00 15 01 00 00 00 00 02 18 00 15 01 00 00 00 00 02 19 00 15 01 00 00 00 00 02 1a 00 15 01 00 00 00 00 02 1b 00 15 01 00 00 00 00 02 1c 00 15 01 00 00 00 00 02 1d 00 15 01 00 00 00 00 02 20 01 15 01 00 00 00 00 02 21 23 15 01 00 00 00 00 02 22 45 15 01 00 00 00 00 02 23 67 15 01 00 00 00 00 02 24 01 15 01 00 00 00 00 02 25 23 15 01 00 00 00 00 02 26 45 15 01 00 00 00 00 02 27 67 15 01 00 00 00 00 02 30 12 15 01 00 00 00 00 02 31 22 15 01 00 00 00 00 02 32 11 15 01 00 00 00 00 02 33 aa 15 01 00 00 00 00 02 34 bb 15 01 00 00 00 00 02 35 66 15 01 00 00 00 00 02 36 00 15 01 00 00 00 00 02 37 22 15 01 00 00 00 00 02 38 22 15 01 00 00 00 00 02 39 22 15 01 00 00 00 00 02 3a 22 15 01 00 00 00 00 02 3b 22 15 01 00 00 00 00 02 3c 22 15 01 00 00 00 00 02 3d 22 15 01 00 00 00 00 02 3e 22 15 01 00 00 00 00 02 3f 22 15 01 00 00 00 00 02 40 22 15 01 00 00 00 00 02 54 13 15 01 00 00 00 00 02 58 57 29 01 00 00 00 00 06 ff ff 98 06 04 07 15 01 00 00 00 00 02 18 1d 15 01 00 00 00 00 02 17 22 15 01 00 00 00 00 02 02 77 15 01 00 00 00 00 02 e1 79 15 01 00 00 00 00 02 26 b2 15 01 00 00 00 00 02 b3 10 29 01 00 00 00 00 06 ff ff 98 06 04 00 05 01 00 00 78 00 02 11 00 05 01 00 00 14 00 02 29 00];
		qcom,mdss-dsi-off-command = [05 01 00 00 32 00 02 28 00 05 01 00 00 78 00 02 10 00];
		qcom,mdss-dsi-on-command-state = "dsi_lp_mode";
		qcom,mdss-dsi-off-command-state = "dsi_lp_mode";
		qcom,mdss-dsi-h-sync-pulse = <0x1>;
		qcom,mdss-dsi-traffic-mode = "burst_mode";
		qcom,mdss-dsi-lane-map = "lane_map_3012";
		qcom,mdss-dsi-bllp-eof-power-mode;
		qcom,mdss-dsi-bllp-power-mode;
		qcom,mdss-dsi-lane-0-state;
		qcom,mdss-dsi-lane-1-state;
		qcom,mdss-dsi-panel-timings = <0x7b1a1000 0x3e40161c 0x15030400>;
		qcom,mdss-dsi-t-clk-post = <0x4>;
		qcom,mdss-dsi-t-clk-pre = <0x1a>;
		qcom,mdss-dsi-dma-trigger = "trigger_sw";
		qcom,mdss-dsi-mdp-trigger = "none";
		qcom,mdss-dsi-reset-sequence = <0x1 0xa 0x0 0xa 0x1 0x14>;
		qcom,mdss-dsi-lp11-init;
		qcom,mdss-dsi-bl-delay-ms = <0x1e>;
		qcom,cont-splash-enabled;
	};
};
