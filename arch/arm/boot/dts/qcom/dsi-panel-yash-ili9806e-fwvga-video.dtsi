/* Copyright (c) 2013, The Linux Foundation. All rights reserved.
 *
 * This program is free software; you can redistribute it and/or modify
 * it under the terms of the GNU General Public License version 2 and
 * only version 2 as published by the Free Software Foundation.
 *
 * This program is distributed in the hope that it will be useful,
 * but WITHOUT ANY WARRANTY; without even the implied warranty of
 * MERCHANTABILITY or FITNESS FOR A PARTICULAR PURPOSE.  See the
 * GNU General Public License for more details.
 */

/*---------------------------------------------------------------------------
 * This file is autogenerated file using gcdb parser. Please do not edit it.
 * Update input XML file to add a new entry or update variable in this file
 * VERSION = "1.0"
 *---------------------------------------------------------------------------*/
&mdss_mdp {
	dsi_yash_ili9806e_fwvga_video: qcom,mdss_dsi_yash_ili9806e_fwvga_video {
		qcom,mdss-dsi-panel-name = "yash ili9806e fwvga video mode dsi panel";
		zte,lcd-proc-panel-name = "zteyash(ili9806e+boe)_480*854-5.0Inch";
		qcom,cont-splash-enabled;
		qcom,mdss-dsi-panel-controller = <&mdss_dsi0>;
		qcom,mdss-dsi-panel-type = "dsi_video_mode";
		qcom,mdss-dsi-panel-destination = "display_1";
		qcom,mdss-dsi-panel-framerate = <60>;
		qcom,mdss-dsi-virtual-channel-id = <0>;
		qcom,mdss-dsi-stream = <0>;
		qcom,mdss-dsi-panel-width = <480>;
		qcom,mdss-dsi-panel-height = <854>;
		qcom,mdss-dsi-h-front-porch = <100>;
		qcom,mdss-dsi-h-back-porch = <94>;
		qcom,mdss-dsi-h-pulse-width = <40>;
		qcom,mdss-dsi-h-sync-skew = <0>;
		qcom,mdss-dsi-v-back-porch = <5>;
		qcom,mdss-dsi-v-front-porch = <6>;
		qcom,mdss-dsi-v-pulse-width = <6>;
		qcom,mdss-dsi-h-left-border = <0>;
		qcom,mdss-dsi-h-right-border = <0>;
		qcom,mdss-dsi-v-top-border = <0>;
		qcom,mdss-dsi-v-bottom-border = <0>;
		qcom,mdss-dsi-bpp = <24>;
		qcom,mdss-dsi-color-order = "rgb_swap_rgb";
		qcom,mdss-dsi-underflow-color = <0xff>;
		qcom,mdss-dsi-border-color = <0>;
		qcom,mdss-dsi-on-command = [39 01 00 00 00 00 06 FF FF 98 06 04 01 
39 01 00 00 00 00 02 08 10 
39 01 00 00 00 00 02 30 01 
39 01 00 00 00 00 02 31 02 
39 01 00 00 00 00 02 60 0F 
39 01 00 00 00 00 02 61 06 
39 01 00 00 00 00 02 62 06 
39 01 00 00 00 00 02 63 04 
39 01 00 00 00 00 02 40 17 
39 01 00 00 00 00 02 41 66 
39 01 00 00 00 00 02 42 02 
39 01 00 00 00 00 02 43 89 
39 01 00 00 00 00 02 44 8C 
39 01 00 00 00 00 02 45 1B 
39 01 00 00 00 00 02 50 80 
39 01 00 00 00 00 02 51 80 
39 01 00 00 00 00 02 52 00 
39 01 00 00 00 00 02 53 41 
39 01 00 00 00 00 02 A0 00 
39 01 00 00 00 00 02 A1 12 
39 01 00 00 00 00 02 A2 16 
39 01 00 00 00 00 02 A3 08 
39 01 00 00 00 00 02 A4 03 
39 01 00 00 00 00 02 A5 0A 
39 01 00 00 00 00 02 A6 03 
39 01 00 00 00 00 02 A7 01 
39 01 00 00 00 00 02 A8 02 
39 01 00 00 00 00 02 A9 0B 
39 01 00 00 00 00 02 AA 08 
39 01 00 00 00 00 02 AB 07 
39 01 00 00 00 00 02 AC 10 
39 01 00 00 00 00 02 AD 20 
39 01 00 00 00 00 02 AE 18 
39 01 00 00 00 00 02 AF 00 
39 01 00 00 00 00 02 C0 00 
39 01 00 00 00 00 02 C1 0C 
39 01 00 00 00 00 02 C2 18 
39 01 00 00 00 00 02 C3 10 
39 01 00 00 00 00 02 C4 06 
39 01 00 00 00 00 02 C5 0D 
39 01 00 00 00 00 02 C6 0C 
39 01 00 00 00 00 02 C7 0E 
39 01 00 00 00 00 02 C8 0A 
39 01 00 00 00 00 02 C9 07 
39 01 00 00 00 00 02 CA 14 
39 01 00 00 00 00 02 CB 07 
39 01 00 00 00 00 02 CC 09 
39 01 00 00 00 00 02 CD 15 
39 01 00 00 00 00 02 CE 11 
39 01 00 00 00 00 02 CF 00 
39 01 00 00 00 00 06 FF FF 98 06 04 07 
39 01 00 00 00 00 02 18 1D 
39 01 00 00 00 00 02 17 12 
39 01 00 00 00 00 02 02 77 
39 01 00 00 00 00 02 E1 79 
39 01 00 00 00 00 06 FF FF 98 06 04 06 
39 01 00 00 00 00 02 00 21 
39 01 00 00 00 00 02 01 05 
39 01 00 00 00 00 02 02 00 
39 01 00 00 00 00 02 03 00 
39 01 00 00 00 00 02 04 01 
39 01 00 00 00 00 02 05 01 
39 01 00 00 00 00 02 06 80 
39 01 00 00 00 00 02 07 04 
39 01 00 00 00 00 02 08 00 
39 01 00 00 00 00 02 09 90 
39 01 00 00 00 00 02 0A 03 
39 01 00 00 00 00 02 0B 00 
39 01 00 00 00 00 02 0C 01 
39 01 00 00 00 00 02 0D 01 
39 01 00 00 00 00 02 0E 00 
39 01 00 00 00 00 02 0F 00 
39 01 00 00 00 00 02 10 50 
39 01 00 00 00 00 02 11 50 
39 01 00 00 00 00 02 12 00 
39 01 00 00 00 00 02 13 85 
39 01 00 00 00 00 02 14 85 
39 01 00 00 00 00 02 15 C0 
39 01 00 00 00 00 02 16 08 
39 01 00 00 00 00 02 17 00 
39 01 00 00 00 00 02 18 00 
39 01 00 00 00 00 02 19 00 
39 01 00 00 00 00 02 1A 00 
39 01 00 00 00 00 02 1B 00 
39 01 00 00 00 00 02 1C 00 
39 01 00 00 00 00 02 1D 00 
39 01 00 00 00 00 02 20 01 
39 01 00 00 00 00 02 21 23 
39 01 00 00 00 00 02 22 45 
39 01 00 00 00 00 02 23 67 
39 01 00 00 00 00 02 24 01 
39 01 00 00 00 00 02 25 23 
39 01 00 00 00 00 02 26 45 
39 01 00 00 00 00 02 27 67 
39 01 00 00 00 00 02 30 10 
39 01 00 00 00 00 02 31 22 
39 01 00 00 00 00 02 32 11 
39 01 00 00 00 00 02 33 AA 
39 01 00 00 00 00 02 34 BB 
39 01 00 00 00 00 02 35 66 
39 01 00 00 00 00 02 36 00 
39 01 00 00 00 00 02 37 22 
39 01 00 00 00 00 02 38 22 
39 01 00 00 00 00 02 39 22 
39 01 00 00 00 00 02 3A 22 
39 01 00 00 00 00 02 3B 22 
39 01 00 00 00 00 02 3C 22 
39 01 00 00 00 00 02 3D 22 
39 01 00 00 00 00 02 3E 22 
39 01 00 00 00 00 02 3F 22 
39 01 00 00 00 00 02 40 22 
39 01 00 00 00 00 02 53 1A 
39 01 00 00 00 00 06 FF FF 98 06 04 00 
05 01 00 00 78 00 02 11 00 
05 01 00 00 20 00 02 29 00];
		qcom,mdss-dsi-off-command = [05 01 00 00 32 00 02 28 00
					05 01 00 00 78 00 02 10 00];
		qcom,mdss-dsi-on-command-state = "dsi_lp_mode";
		qcom,mdss-dsi-off-command-state = "dsi_hs_mode";
		qcom,mdss-dsi-h-sync-pulse = <1>;
		qcom,mdss-dsi-traffic-mode = "burst_mode";
		qcom,mdss-dsi-lane-map = "lane_map_0123";
		qcom,mdss-dsi-bllp-eof-power-mode;
		qcom,mdss-dsi-bllp-power-mode;
		qcom,mdss-dsi-lane-0-state;
		qcom,mdss-dsi-lane-1-state;
		qcom,mdss-dsi-panel-timings = [87 1C 12 00 40 44 16 1E 17 03 04 00];
		qcom,mdss-dsi-t-clk-post = <0x04>;
		qcom,mdss-dsi-t-clk-pre = <0x1B>;
		qcom,mdss-dsi-bl-min-level = <2>;
		qcom,mdss-dsi-bl-max-level = <88>;
		qcom,mdss-dsi-dma-trigger = "trigger_sw";
		qcom,mdss-dsi-mdp-trigger = "none";
		qcom,mdss-dsi-bl-pmic-control-type = "bl_ctrl_gpio";
		qcom,mdss-dsi-reset-sequence = <1 20>, <0 20>, <1 120>;
	};
};
