/* Copyright (c) 2013, The Linux Foundation. All rights reserved.
 *
 * This program is free software; you can redistribute it and/or modify
 * it under the terms of the GNU General Public License version 2 and
 * only version 2 as published by the Free Software Foundation.
 *
 * This program is distributed in the hope that it will be useful,
 * but WITHOUT ANY WARRANTY; without even the implied warranty of
 * MERCHANTABILITY or FITNESS FOR A PARTICULAR PURPOSE.  See the
 * GNU General Public License for more details.
 */

/*---------------------------------------------------------------------------
 * This file is autogenerated file using gcdb parser. Please do not edit it.
 * Update input XML file to add a new entry or update variable in this file
 * VERSION = "1.0"
 *---------------------------------------------------------------------------*/
&mdss_mdp {
	dsi_ili9806e_fwvga_hsd_huashi_video: qcom,mdss_dsi_ili9806e_fwvga_hsd_huashi_video {
		qcom,mdss-dsi-panel-name = "ILI9806E fwvga  hsd huashi video mode dsi panel";
		qcom,mdss-dsi-panel-controller = <&mdss_dsi0>;
		qcom,mdss-dsi-panel-type = "dsi_video_mode";
		qcom,mdss-dsi-panel-destination = "display_1";
		qcom,mdss-dsi-panel-framerate = <60>;
		qcom,mdss-dsi-virtual-channel-id = <0>;
		qcom,mdss-dsi-stream = <0>;
		qcom,mdss-dsi-panel-width = <480>;
		qcom,mdss-dsi-panel-height = <854>;
		qcom,mdss-dsi-h-front-porch = <80>;
		qcom,mdss-dsi-h-back-porch = <100>;
		qcom,mdss-dsi-h-pulse-width = <10>;
		qcom,mdss-dsi-h-sync-skew = <0>;
		qcom,mdss-dsi-v-back-porch = <16>;
		qcom,mdss-dsi-v-front-porch = <20>;
		qcom,mdss-dsi-v-pulse-width = <4>;
		qcom,mdss-dsi-h-left-border = <0>;
		qcom,mdss-dsi-h-right-border = <0>;
		qcom,mdss-dsi-v-top-border = <0>;
		qcom,mdss-dsi-v-bottom-border = <0>;
		qcom,mdss-dsi-bpp = <24>;
		qcom,mdss-dsi-underflow-color = <0xff>;
		qcom,mdss-dsi-border-color = <0>;
		qcom,mdss-dsi-on-command = <0x29010000 0x6ff 0xff980604 0x1290100 0x2 0x8102901 0x0 0x2210129 0x1000000 0x23001 0x29010000 0x231 0x2290100 0x2 0x40182901 0x0 0x2413329 0x1000000 0x24203 0x29010000 0x243 0x9290100 0x2 0x44072901 0x0 0x2451629 0x1000000 0x25078 0x29010000 0x251 0x78290100 0x2 0x52002901 0x0 0x2534529 0x1000000 0x2600a 0x29010000 0x261 0x290100 0x2 0x62082901 0x0 0x2630029 0x1000000 0x2a000 0x29010000 0x2a1 0x8290100 0x2 0xa2122901 0x0 0x2a31029 0x1000000 0x2a409 0x29010000 0x2a5 0x19290100 0x2 0xa60a2901 0x0 0x2a70a29 0x1000000 0x2a802 0x29010000 0x2a9 0x7290100 0x2 0xaa052901 0x0 0x2ab0629 0x1000000 0x2ac0a 0x29010000 0x2ad 0x33290100 0x2 0xae2f2901 0x0 0x2af0029 0x1000000 0x2c000 0x29010000 0x2c1 0x7290100 0x2 0xc2102901 0x0 0x2c30f29 0x1000000 0x2c408 0x29010000 0x2c5 0x13290100 0x2 0xc6072901 0x0 0x2c70729 0x1000000 0x2c805 0x29010000 0x2c9 0xa290100 0x2 0xca092901 0x0 0x2cb0529 0x1000000 0x2cc0e 0x29010000 0x2cd 0x27290100 0x2 0xce222901 0x0 0x2cf0029 0x1000000 0x6ffff 0x98060406 0x29010000 0x200 0x21290100 0x2 0x10a2901 0x0 0x2020029 0x1000000 0x20300 0x29010000 0x204 0x1290100 0x2 0x5012901 0x0 0x2068029 0x1000000 0x20706 0x29010000 0x208 0x1290100 0x2 0x9802901 0x0 0x20a0029 0x1000000 0x20b00 0x29010000 0x20c 0xa290100 0x2 0xd0a2901 0x0 0x20e0029 0x1000000 0x20f00 0x29010000 0x210 0xf0290100 0x2 0x11f42901 0x0 0x2120429 0x1000000 0x21300 0x29010000 0x214 0x290100 0x2 0x15c02901 0x0 0x2160829 0x1000000 0x21700 0x29010000 0x218 0x290100 0x2 0x19002901 0x0 0x21a0029 0x1000000 0x21b00 0x29010000 0x21c 0x290100 0x2 0x1d002901 0x0 0x2200129 0x1000000 0x22123 0x29010000 0x222 0x45290100 0x2 0x23672901 0x0 0x2240129 0x1000000 0x22523 0x29010000 0x226 0x45290100 0x2 0x27672901 0x0 0x2300129 0x1000000 0x23111 0x29010000 0x232 0x290100 0x2 0x33ee2901 0x0 0x234ff29 0x1000000 0x235bb 0x29010000 0x236 0xca290100 0x2 0x37dd2901 0x0 0x238ac29 0x1000000 0x23976 0x29010000 0x23a 0x67290100 0x2 0x3b222901 0x0 0x23c2229 0x1000000 0x23d22 0x29010000 0x23e 0x22290100 0x2 0x3f222901 0x0 0x2402229 0x1000000 0x25210 0x29010000 0x253 0x10290100 0x6 0xffff9806 0x4072901 0x0 0x2181d29 0x1000000 0x21722 0x29010000 0x202 0x77290100 0x2 0x26b22901 0x0 0x2e17929 0x1000000 0x20613 0x29010000 0x6ff 0xff980604 0x290100 0x2 0x36000501 0x7800 0x2110005 0x1000032 0x22900>;
		qcom,mdss-dsi-off-command = [05 01 00 00 32 00 02 28 00
					05 01 00 00 78 00 02 10 00];
		qcom,mdss-dsi-on-command-state = "dsi_lp_mode";
		qcom,mdss-dsi-off-command-state = "dsi_lp_mode";
		qcom,mdss-dsi-h-sync-pulse = <1>;
		qcom,mdss-dsi-traffic-mode = "non_burst_sync_pulse";
		qcom,mdss-dsi-lane-map = "lane_map_0123";
		qcom,mdss-dsi-bllp-eof-power-mode;
		qcom,mdss-dsi-bllp-power-mode;
		qcom,mdss-dsi-lane-0-state;
		qcom,mdss-dsi-lane-1-state;
		qcom,mdss-dsi-panel-timings = [73 19 10 00 3C 46 14 1C 1C 03 04 00];
		qcom,mdss-dsi-t-clk-post = <0x04>;
		qcom,mdss-dsi-t-clk-pre = <0x1b>;
		qcom,mdss-dsi-bl-min-level = <1>;
		qcom,mdss-dsi-bl-max-level = <255>;
		qcom,mdss-dsi-dma-trigger = "trigger_sw";
		qcom,cont-splash-enabled;
		qcom,mdss-dsi-bl-pmic-control-type = "bl_ctrl_pwm";
		qcom,mdss-dsi-bl-pmic-pwm-frequency = <100>;
		qcom,mdss-dsi-bl-pmic-bank-select = <0>;
		qcom,mdss-dsi-pwm-gpio = <&pm8909_mpps 2 0>;
		qcom,mdss-dsi-mdp-trigger = "none";
		qcom,mdss-dsi-reset-sequence = <1 20>, <0 20>, <1 20>;
		qcom,mdss-dsi-lp11-init;
		qcom,mdss-dsi-init-delay-us = <50000>;
	};
};
