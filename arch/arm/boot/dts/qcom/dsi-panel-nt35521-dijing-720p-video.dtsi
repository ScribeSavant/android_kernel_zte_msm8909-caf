/* Copyright (c) 2013-2014, The Linux Foundation. All rights reserved.
 *
 * This program is free software; you can redistribute it and/or modify
 * it under the terms of the GNU General Public License version 2 and
 * only version 2 as published by the Free Software Foundation.
 *
 * This program is distributed in the hope that it will be useful,
 * but WITHOUT ANY WARRANTY; without even the implied warranty of
 * MERCHANTABILITY or FITNESS FOR A PARTICULAR PURPOSE.  See the
 * GNU General Public License for more details.
 */

&mdss_mdp {
	dsi_nt35521_dijing_720_vid: qcom,mdss_dsi_nt35521_dijing_720p_video {
		qcom,mdss-dsi-panel-name = "nt35521 dijing 720p video mode dsi panel";
		zte,lcd-proc-panel-name = "zteDIJING(nt35521+boe)_720*1280-5.2Inch";
	        qcom,cont-splash-enabled;
		qcom,mdss-dsi-panel-controller = <&mdss_dsi0>;
		qcom,mdss-dsi-panel-type = "dsi_video_mode";
		qcom,mdss-dsi-panel-destination = "display_1";
		qcom,mdss-dsi-panel-framerate = <60>;
		qcom,mdss-dsi-virtual-channel-id = <0>;
		qcom,mdss-dsi-stream = <0>;
		qcom,mdss-dsi-panel-width = <720>;
		qcom,mdss-dsi-panel-height = <1280>;
		qcom,mdss-dsi-h-front-porch = <44>;
		qcom,mdss-dsi-h-back-porch = <20>;
		qcom,mdss-dsi-h-pulse-width = <8>;
		qcom,mdss-dsi-h-sync-skew = <0>;
		qcom,mdss-dsi-v-back-porch = <10>;
		qcom,mdss-dsi-v-front-porch = <10>;
		qcom,mdss-dsi-v-pulse-width = <8>;
		qcom,mdss-dsi-h-left-border = <0>;
		qcom,mdss-dsi-h-right-border = <0>;
		qcom,mdss-dsi-v-top-border = <0>;
		qcom,mdss-dsi-v-bottom-border = <0>;
		qcom,mdss-dsi-bpp = <24>;
		qcom,mdss-dsi-underflow-color = <0xff>;
		qcom,mdss-dsi-border-color = <0>;
		qcom,mdss-dsi-pixel-packing = "tight";
		qcom,mdss-dsi-on-command = [
		29 01 00 00 00 00 05 FF AA 55 25 01
29 01 00 00 01 00 02 FC 08
//Delay 1
29 01 00 00 01 00 02 FC 00 
//Delay 1
29 01 00 00 00 00 02 6F 21
29 01 00 00 01 00 02 F7 01
//DELAY 1
29 01 00 00 00 00 02 6F 21
29 01 00 00 01 00 02 F7 00
//Delay 1
29 01 00 00 00 00 02 6F 1A
29 01 00 00 01 00 02 F7 05
//Delay 1
29 01 00 00 00 00 05 FF AA 55 25 00
29 01 00 00 00 00 06 F0 55 AA 52 08 00
29 01 00 00 00 00 03 D9 02 0A
29 01 00 00 00 00 06 BD 01 A0 0C 08 01
29 01 00 00 00 00 03 B1 68 21
29 01 00 00 00 00 02 6F 02
29 01 00 00 00 00 02 B8 01
29 01 00 00 00 00 03 BB 11 11
29 01 00 00 00 00 03 BC 00 00
29 01 00 00 00 00 02 B6 06
29 01 00 00 00 00 02 C8 80
29 01 00 00 00 00 06 F0 55 AA 52 08 01
29 01 00 00 00 00 03 B0 09 09
29 01 00 00 00 00 03 B1 09 09
29 01 00 00 00 00 03 BC 78 00
29 01 00 00 00 00 03 BD 78 00
29 01 00 00 00 00 02 CA 00
29 01 00 00 00 00 02 C0 0C
29 01 00 00 00 00 03 B5 03 03
29 01 00 00 00 00 02 BE 46
29 01 00 00 00 00 03 B3 19 19
29 01 00 00 00 00 03 B4 19 19
29 01 00 00 00 00 03 B9 24 24
29 01 00 00 00 00 03 BA 25 25
29 01 00 00 00 00 06 F0 55 AA 52 08 02
29 01 00 00 00 00 02 EE 01
29 01 00 00 00 00 11 B0 00 00 00 B2 00 D4 00 F0 01 06 01 26 01 41 01 6D
29 01 00 00 00 00 11 B1 01 90 01 C7 01 F2 02 37 02 6F 02 70 02 A2 02 D7
29 01 00 00 00 00 11 B2 02 F8 03 23 03 40 03 68 03 82 03 A2 03 B8 03 D2
29 01 00 00 00 00 05 B3 03 F3 03 FF
29 01 00 00 00 00 06 F0 55 AA 52 08 06
29 01 00 00 00 00 03 B0 11 13
29 01 00 00 00 00 03 B1 17 19
29 01 00 00 00 00 03 B2 01 03
29 01 00 00 00 00 03 B3 2E 2E
29 01 00 00 00 00 03 B4 2E 2E
29 01 00 00 00 00 03 B5 2E 2E
29 01 00 00 00 00 03 B6 2E 2E
29 01 00 00 00 00 03 B7 2E 2E
29 01 00 00 00 00 03 B8 2E 2E
29 01 00 00 00 00 03 B9 2E 2D
29 01 00 00 00 00 03 BA 2D 2E
29 01 00 00 00 00 03 BB 2E 2E
29 01 00 00 00 00 03 BC 2E 2E
29 01 00 00 00 00 03 BD 2E 2E
29 01 00 00 00 00 03 BE 2E 2E
29 01 00 00 00 00 03 BF 2E 2E
29 01 00 00 00 00 03 C0 2E 2E
29 01 00 00 00 00 03 C1 02 00
29 01 00 00 00 00 03 C2 18 16
29 01 00 00 00 00 03 C3 12 10
29 01 00 00 00 00 03 E5 31 31
29 01 00 00 00 00 03 C4 18 16
29 01 00 00 00 00 03 C5 12 10
29 01 00 00 00 00 03 C6 02 00
29 01 00 00 00 00 03 C7 2E 2E
29 01 00 00 00 00 03 C8 2E 2E
29 01 00 00 00 00 03 C9 2E 2E
29 01 00 00 00 00 03 CA 2E 2E
29 01 00 00 00 00 03 CB 2E 2E
29 01 00 00 00 00 03 CC 2E 2E
29 01 00 00 00 00 03 CD 2D 2E
29 01 00 00 00 00 03 CE 2E 2D
29 01 00 00 00 00 03 CF 2E 2E
29 01 00 00 00 00 03 D0 2E 2E
29 01 00 00 00 00 03 D1 2E 2E
29 01 00 00 00 00 03 D2 2E 2E
29 01 00 00 00 00 03 D3 2E 2E
29 01 00 00 00 00 03 D4 2E 2E
29 01 00 00 00 00 03 D5 01 03
29 01 00 00 00 00 03 D6 11 13
29 01 00 00 00 00 03 D7 17 19
29 01 00 00 00 00 03 E6 31 31
29 01 00 00 00 00 06 D8 00 00 00 00 00
29 01 00 00 00 00 06 D9 00 00 00 00 00
29 01 00 00 00 00 02 E7 00
29 01 00 00 00 00 06 F0 55 AA 52 08 03
29 01 00 00 00 00 03 B1 20 00
29 01 00 00 00 00 03 B0 20 00
29 01 00 00 00 00 06 B2 05 00 00 00 00
29 01 00 00 00 00 06 B3 05 00 00 00 00
29 01 00 00 00 00 06 B4 05 00 00 00 00
29 01 00 00 00 00 06 B5 05 00 00 00 00
29 01 00 00 00 00 06 BA 53 00 00 00 00
29 01 00 00 00 00 06 BB 53 00 00 00 00
29 01 00 00 00 00 06 BC 53 00 00 00 00
29 01 00 00 00 00 06 BD 53 00 00 00 00
29 01 00 00 00 00 02 C4 60
29 01 00 00 00 00 02 C5 40
29 01 00 00 00 00 06 F0 55 AA 52 08 05
29 01 00 00 00 00 03 B0 17 06
29 01 00 00 00 00 03 B1 17 06
29 01 00 00 00 00 03 B2 17 06
29 01 00 00 00 00 03 B3 17 06
29 01 00 00 00 00 03 B4 17 06
29 01 00 00 00 00 03 B5 17 06
29 01 00 00 00 00 03 B6 17 06
29 01 00 00 00 00 03 B7 17 06
29 01 00 00 00 00 02 B8 00
29 01 00 00 00 00 03 B9 00 03
29 01 00 00 00 00 03 BA 00 00
29 01 00 00 00 00 03 BB 00 00
29 01 00 00 00 00 03 BC 00 03
29 01 00 00 00 00 06 BD 03 03 01 00 03
29 01 00 00 00 00 02 E5 06
29 01 00 00 00 00 02 E6 06
29 01 00 00 00 00 02 E7 06
29 01 00 00 00 00 02 E8 06
29 01 00 00 00 00 02 E9 06
29 01 00 00 00 00 02 EA 06
29 01 00 00 00 00 02 EB 06
29 01 00 00 00 00 02 EC 06
29 01 00 00 00 00 02 C0 0B
29 01 00 00 00 00 02 C1 09
29 01 00 00 00 00 03 C8 07 20
29 01 00 00 00 00 03 C9 03 20
29 01 00 00 00 00 08 D0 00 00 00 00 00 00 00
29 01 00 00 00 00 06 D1 03 05 00 07 00
29 01 00 00 00 00 06 D2 03 05 04 07 00
29 01 00 00 00 00 06 D3 00 00 0A 07 10
29 01 00 00 00 00 06 D4 00 00 0A 07 10
29 01 00 00 00 00 0C D5 00 00 00 00 00 00 00 00 00 00 00
29 01 00 00 00 00 0C D6 00 00 00 00 00 00 00 00 00 00 00
29 01 00 00 00 00 0C D7 00 00 00 00 00 00 00 00 00 00 00
29 01 00 00 00 00 06 D8 00 00 00 00 00
29 01 00 00 00 00 02 ED 30
29 01 00 00 00 00 02 35 00
29 01 00 00 00 00 02 51 00 
29 01 00 00 00 00 02 53 2C 
29 01 00 00 00 00 02 55 01
05 01 00 00 78 00 02 11 00 
05 01 00 00 0A 00 02 29 00 
];
		qcom,mdss-dsi-off-command = [05 01 00 00 14 00 02 28 00
					05 01 00 00 78 00 02 10 00];
		qcom,mdss-dsi-on-command-state = "dsi_lp_mode";
		qcom,mdss-dsi-off-command-state = "dsi_hs_mode";
		qcom,mdss-dsi-h-sync-pulse = <1>;
		qcom,mdss-dsi-traffic-mode = "burst_mode";
		qcom,mdss-dsi-bllp-eof-power-mode;
		qcom,mdss-dsi-bllp-power-mode;
		qcom,mdss-dsi-lane-0-state;
		qcom,mdss-dsi-lane-1-state;
		qcom,mdss-dsi-lane-2-state;
		qcom,mdss-dsi-lane-3-state;
		qcom,mdss-dsi-panel-timings = [6D 18 10 00 3A 3E 12 1A 13 03 04 00];
		qcom,mdss-dsi-t-clk-post = <0x4>;
		qcom,mdss-dsi-t-clk-pre = <0x18>;
		qcom,mdss-dsi-bl-min-level = <1>;
		qcom,mdss-dsi-bl-max-level = <238>;
		qcom,mdss-dsi-dma-trigger = "trigger_sw";
		qcom,mdss-dsi-mdp-trigger = "none";
		qcom,mdss-dsi-bl-pmic-control-type = "bl_ctrl_dcs";
		qcom,mdss-dsi-reset-sequence = <1 20>, <0 20>, <1 60>;
		qcom,mdss-pan-physical-width-dimension = <62>;
		qcom,mdss-pan-physical-height-dimension = <110>;
	};
};
