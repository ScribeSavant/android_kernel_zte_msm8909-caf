/* Copyright (c) 2013-2014, The Linux Foundation. All rights reserved.
 *
 * This program is free software; you can redistribute it and/or modify
 * it under the terms of the GNU General Public License version 2 and
 * only version 2 as published by the Free Software Foundation.
 *
 * This program is distributed in the hope that it will be useful,
 * but WITHOUT ANY WARRANTY; without even the implied warranty of
 * MERCHANTABILITY or FITNESS FOR A PARTICULAR PURPOSE.  See the
 * GNU General Public License for more details.
 */

&mdss_mdp {
	dsi_hx8394f_lead_720p_video: qcom,mdss_dsi_hx8394f_lead_720p_video {
		qcom,mdss-dsi-panel-name = "hx8394f lead 720p video mode dsi panel";
		zte,lcd-proc-panel-name = "zteLEAD(hx8394f+boe)_720*1280-5.0Inch";
	        qcom,cont-splash-enabled;
		qcom,mdss-dsi-panel-controller = <&mdss_dsi0>;
		qcom,mdss-dsi-panel-type = "dsi_video_mode";
		qcom,mdss-dsi-panel-destination = "display_1";
		qcom,mdss-dsi-panel-framerate = <60>;
		qcom,mdss-dsi-virtual-channel-id = <0>;
		qcom,mdss-dsi-stream = <0>;
		qcom,mdss-dsi-panel-width = <720>;
		qcom,mdss-dsi-panel-height = <1280>;
		qcom,mdss-dsi-h-front-porch = <60>;
		qcom,mdss-dsi-h-back-porch = <40>;
		qcom,mdss-dsi-h-pulse-width = <12>;
		qcom,mdss-dsi-h-sync-skew = <0>;
		qcom,mdss-dsi-v-back-porch = <16>;//0x8
		qcom,mdss-dsi-v-front-porch = <9>;//0x12
		qcom,mdss-dsi-v-pulse-width = <2>;
		qcom,mdss-dsi-h-left-border = <0>;
		qcom,mdss-dsi-h-right-border = <0>;
		qcom,mdss-dsi-v-top-border = <0>;
		qcom,mdss-dsi-v-bottom-border = <0>;
		qcom,mdss-dsi-bpp = <24>;
		qcom,mdss-dsi-color-order = "rgb_swap_rgb";
		qcom,mdss-dsi-underflow-color = <0xff>;
		qcom,mdss-dsi-border-color = <0>;
		qcom,mdss-dsi-on-command = [
39 01 00 00 00 00 04 B9 FF 83 94 
39 01 00 00 00 00 0B B1 50 15 75 09 32 44 71 31 55 2F
39 01 00 00 00 00 09 BA 63 03 68 6B B2 C0 00 11
39 01 00 00 00 00 02 D2 88 
39 01 00 00 00 00 06 B2 00 80 64 10 07

39 01 00 00 00 00 16 B4 01 65 01 65 01 65 01 05 7E 36 00 3F 01 65 01 65 01 65 01 05 7E
39 01 00 00 00 00 22 D3 00 00 0F 0F 40 1E 08 00 32 10 08 00 08 54 15 10 05 04 02 12 10 05 07 23 23 0C 0C 27 10 07 07 10 40

39 01 00 00 00 00 2D D5 19 19 18 18 1B 1B 1A 1A 04 05 06 07 00 01 02 03 20 21 18 18 22 23 18 18 18 18 18 18 18 18 18 18 18 18 18 18 18 18 18 18 18 18 18 18
39 01 00 00 00 00 2D D6 18 18 19 19 1B 1B 1A 1A 03 02 01 00 07 06 05 04 23 22 18 18 21 20 18 18 18 18 18 18 18 18 18 18 18 18 18 18 18 18 18 18 18 18 18 18 
39 01 00 00 00 00 3B E0 00 0B 17 1E 20 24 28 26 4E 5D 6D 6B 74 84 89 8E 9A 9B 96 A4 B2 58 55 59 5B 5D 60 64 7F 00 0B 17 1D 20 24 28 26 4E 5D 6D 6B 74 85 8A 8E 9A 9B 97 A5 B2 58 55 58 5B 5D 61 65 7F

39 01 00 00 00 00 02 CC 0B 
39 01 00 00 00 00 03 C0 1F 73 
39 01 00 00 00 00 03 B6 70 70 
39 01 00 00 00 00 02 D4 02 
39 01 00 00 00 00 02 BD 01 
39 01 00 00 00 00 02 B1 60

39 01 00 00 00 00 02 BD 00 
39 01 00 00 00 00 07 C9 13 00 12 10 B1 10
39 01 00 00 00 00 08 BF 40 81 50 00 1A FC 01

39 01 00 00 0A 00 03 E4 01 01

05 01 00 00 78 00 02 11 00 
05 01 00 00 0A 00 02 29 00 
39 01 00 00 00 00 02 51 00 
39 01 00 00 00 00 02 53 2C 
39 01 00 00 00 00 02 55 01 ];
		qcom,mdss-dsi-off-command = [05 01 00 00 14 00 02 28 00
39 01 00 00 0A 00 09 B1 51
05 01 00 00 78 00 02 10 00];
		qcom,mdss-dsi-on-command-state = "dsi_lp_mode";
		qcom,mdss-dsi-off-command-state = "dsi_lp_mode";
		qcom,mdss-dsi-h-sync-pulse = <1>;
		qcom,mdss-dsi-traffic-mode = "burst_mode";
		qcom,mdss-dsi-bllp-eof-power-mode;
		qcom,mdss-dsi-bllp-power-mode;
		qcom,mdss-dsi-lane-0-state;
		qcom,mdss-dsi-lane-1-state;
		qcom,mdss-dsi-lane-2-state;
		qcom,mdss-dsi-lane-3-state;
		qcom,mdss-dsi-panel-timings = [76 18 10 00 3C 3E 14 1C 12 03 04 00];
		qcom,mdss-dsi-t-clk-post = <0x04>;
		qcom,mdss-dsi-t-clk-pre = <0x19>;
		qcom,mdss-dsi-bl-min-level = <1>;
		qcom,mdss-dsi-bl-max-level = <238>;
		qcom,mdss-dsi-dma-trigger = "trigger_sw";
		qcom,mdss-dsi-mdp-trigger = "none";
		qcom,mdss-dsi-bl-pmic-control-type = "bl_ctrl_dcs";
		qcom,mdss-dsi-reset-sequence = <1 20>, <0 10>, <1 60>;
        qcom,mdss-dsi-lp11-init;
		qcom,mdss-pan-physical-width-dimension = <62>;
		qcom,mdss-pan-physical-height-dimension = <110>;
	};
};
