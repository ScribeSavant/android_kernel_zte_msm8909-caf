/* Copyright (c) 2015, The Linux Foundation. All rights reserved.
 *
 * This program is free software; you can redistribute it and/or modify
 * it under the terms of the GNU General Public License version 2 and
 * only version 2 as published by the Free Software Foundation.
 *
 * This program is distributed in the hope that it will be useful,
 * but WITHOUT ANY WARRANTY; without even the implied warranty of
 * MERCHANTABILITY or FITNESS FOR A PARTICULAR PURPOSE.  See the
 * GNU General Public License for more details.
 */

&mdss_mdp {
	dsi_fl10802_txd_fwvga_video: qcom,mdss_dsi_fl10802_txd_fwvga_video {
		qcom,mdss-dsi-panel-name = "fl10802 txd fwvga video mode dsi panel";
		zte,lcd-proc-panel-name = "zteTXD(fl10802+boe)_480*854-5.0Inch";
	        qcom,cont-splash-enabled;
		qcom,mdss-dsi-panel-controller = <&mdss_dsi0>;
		qcom,mdss-dsi-panel-type = "dsi_video_mode";
		qcom,mdss-dsi-panel-destination = "display_1";
		qcom,mdss-dsi-panel-framerate = <60>;
		qcom,mdss-dsi-virtual-channel-id = <0>;
		qcom,mdss-dsi-stream = <0>;
		qcom,mdss-dsi-panel-width = <480>;
		qcom,mdss-dsi-panel-height = <854>;
		qcom,mdss-dsi-h-front-porch = <70>;
		qcom,mdss-dsi-h-back-porch = <70>;
		qcom,mdss-dsi-h-pulse-width = <20>;//10
		qcom,mdss-dsi-h-sync-skew = <0>;
		qcom,mdss-dsi-v-back-porch = <12>;
		qcom,mdss-dsi-v-front-porch = <17>;
		qcom,mdss-dsi-v-pulse-width = <4>;
		qcom,mdss-dsi-h-left-border = <0>;
		qcom,mdss-dsi-h-right-border = <0>;
		qcom,mdss-dsi-v-top-border = <0>;
		qcom,mdss-dsi-v-bottom-border = <0>;
		qcom,mdss-dsi-bpp = <24>;
		qcom,mdss-dsi-color-order = "rgb_swap_rgb";
		qcom,mdss-dsi-underflow-color = <0xff>;
		qcom,mdss-dsi-border-color = <0>;
		qcom,mdss-dsi-on-command = [
39 01 00 00 00 00 04 B9 F1 08 01           
39 01 00 00 00 00 05 B1 22 1E 1E 87           
39 01 00 00 00 00 02 B2 22           
39 01 00 00 00 00 09 B3 01 00 06 06 18 13 39 35           
39 01 00 00 00 00 12 BA 31 00 44 25 91 0A 00 00 C1 00 00 00 0D 02 4F B9 EE           
39 01 00 00 00 00 06 E3 03 03 03 03 C0           
39 01 00 00 00 00 02 B4 00           
39 01 00 00 00 00 03 B5 0D 0D           
39 01 00 00 00 00 03 B6 54 54           
39 01 00 00 00 00 03 B8 64 28          
39 01 00 00 00 00 02 CC 00           
39 01 00 00 00 00 02 BC 47           
39 01 00 00 00 00 34 E9 00 00 06 00 00 0A 80 12 30 00 23 0A 0A 80 27 00 03 00 00 00 08 08 98 DD 20 64 02 88 88 88 88 98 DD 31 75 13 88 88 88 88 00 00 00 00 00 00 00 00 00 00 00           
39 01 00 00 00 00 17 EA 06 00 00 00 89 DD 35 71 31 88 88 88 88 89 DD 24 60 20 88 88 88 88 
39 01 00 00 00 00 23 E0 00 00 00 17 20 3F 29 3c 04 0e 13 18 1a 17 17 12 18 00 00 00 17 20 3F 29 3c 04 0e 13 18 1a 17 17 12 18 
05 01 00 00 78 00 02 11 00
05 01 00 00 14 00 02 29 00];
		qcom,mdss-dsi-off-command = [05 01 00 00 32 00 02 28 00
					05 01 00 00 78 00 02 10 00];
		qcom,mdss-dsi-on-command-state = "dsi_lp_mode";
		qcom,mdss-dsi-off-command-state = "dsi_hs_mode";
		qcom,mdss-dsi-h-sync-pulse = <1>;
		qcom,mdss-dsi-traffic-mode = "burst_mode";
		qcom,mdss-dsi-lane-map = "lane_map_0123";
		qcom,mdss-dsi-bllp-eof-power-mode;
		qcom,mdss-dsi-bllp-power-mode;
		qcom,mdss-dsi-lane-0-state;
		qcom,mdss-dsi-lane-1-state;
		//qcom,mdss-dsi-lane-2-state;
		//qcom,mdss-dsi-lane-3-state;
		qcom,mdss-dsi-panel-timings = [7B 1A 10 00 3C 42 14 1C 15 03 04 00];
		qcom,mdss-dsi-t-clk-post = <0x4>;
		qcom,mdss-dsi-t-clk-pre = <0x1A>;
		qcom,mdss-dsi-bl-min-level = <2>;
		qcom,mdss-dsi-bl-max-level = <88>;
		qcom,mdss-dsi-dma-trigger = "trigger_sw";
		qcom,mdss-dsi-mdp-trigger = "none";
		qcom,mdss-dsi-bl-pmic-control-type = "bl_ctrl_gpio";
		qcom,mdss-dsi-reset-sequence = <1 20>, <0 20>, <1 120>;
		qcom,mdss-dsi-lp11-init;
		qcom,mdss-dsi-init-delay-us = <7000>;
		qcom,mdss-pan-physical-width-dimension = <62>;
		qcom,mdss-pan-physical-height-dimension = <110>;
	};
};
