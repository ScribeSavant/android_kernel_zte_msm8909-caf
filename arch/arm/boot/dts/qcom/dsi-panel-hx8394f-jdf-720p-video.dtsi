/* Copyright (c) 2013-2014, The Linux Foundation. All rights reserved.
 *
 * This program is free software; you can redistribute it and/or modify
 * it under the terms of the GNU General Public License version 2 and
 * only version 2 as published by the Free Software Foundation.
 *
 * This program is distributed in the hope that it will be useful,
 * but WITHOUT ANY WARRANTY; without even the implied warranty of
 * MERCHANTABILITY or FITNESS FOR A PARTICULAR PURPOSE.  See the
 * GNU General Public License for more details.
 */

&mdss_mdp {
	dsi_hx8394f_jdf_720p_video: qcom,mdss_dsi_hx8394f_jdf_720p_video {
		qcom,mdss-dsi-panel-name = "hx8394f jdf 720p video mode dsi panel";
		zte,lcd-proc-panel-name = "zteJDF(hx8394f+boe)_720*1280-5.2Inch";
	        qcom,cont-splash-enabled;
		qcom,mdss-dsi-panel-controller = <&mdss_dsi0>;
		qcom,mdss-dsi-panel-type = "dsi_video_mode";
		qcom,mdss-dsi-panel-destination = "display_1";
		qcom,mdss-dsi-panel-framerate = <60>;
		qcom,mdss-dsi-virtual-channel-id = <0>;
		qcom,mdss-dsi-stream = <0>;
		qcom,mdss-dsi-panel-width = <720>;
		qcom,mdss-dsi-panel-height = <1280>;
		qcom,mdss-dsi-h-front-porch = <108>;
		qcom,mdss-dsi-h-back-porch = <109>;
		qcom,mdss-dsi-h-pulse-width = <36>;
		qcom,mdss-dsi-h-sync-skew = <0>;
		qcom,mdss-dsi-v-back-porch = <16>;//0x8
		qcom,mdss-dsi-v-front-porch = <9>;//0x12
		qcom,mdss-dsi-v-pulse-width = <2>;
		qcom,mdss-dsi-h-left-border = <0>;
		qcom,mdss-dsi-h-right-border = <0>;
		qcom,mdss-dsi-v-top-border = <0>;
		qcom,mdss-dsi-v-bottom-border = <0>;
		qcom,mdss-dsi-bpp = <24>;
		qcom,mdss-dsi-color-order = "rgb_swap_rgb";
		qcom,mdss-dsi-underflow-color = <0xff>;
		qcom,mdss-dsi-border-color = <0>;
		qcom,mdss-dsi-on-command = [
39 01 00 00 00 00 04 B9 FF 83 94 
39 01 00 00 00 00 0B B1 48 0C 6C 09 33 54 71 71 2E 45
39 01 00 00 00 00 07 BA 63 03 68 6B B2 C0
39 01 00 00 00 00 02 D2 66 
39 01 00 00 00 00 07 B2 00 80 64 0c 06 2f

39 01 00 00 00 00 17 B4 76 74 76 74 76 74 01 0c 84 35 00 3f 76 74 76 74 76 74 01 0c 84 3F
39 01 00 00 00 00 22 D3 00 00 00 00 00 00 08 08 32 10 02 00 02 32 13 C0 00 00 32 10 08 00 00 47 04 06 06 47 08 08 47 0C 40

39 01 00 00 00 00 2D D5 01 00 03 02 05 04 07 06 21 20 23 22 18 18 18 18 18 18 18 18 18 18 18 18 18 18 18 18 18 18 18 18 18 18 18 18 18 18 18 18 18 18 19 19
39 01 00 00 00 00 2D D6 06 07 04 05 02 03 00 01 22 23 20 21 18 18 18 18 18 18 18 18 18 18 18 18 18 18 18 18 18 18 18 18 18 18 18 18 18 18 18 18 19 19 18 18 
39 01 00 00 00 00 3B E0 00 16 24 2D 30 35 38 37 71 82 93 92 9B AD B0 B4 BE BE B8 C2 CF 65 62 64 67 68 6B 7F 7F 00 16 24 2D 30 35 38 37 71 82 93 92 9B AD B0 B5 C0 BF B9 C3 CF 66 63 65 68 6A 72 7F 7F

39 01 00 00 00 00 02 CC 0B 
39 01 00 00 00 00 03 C0 1F 73 
39 01 00 00 00 00 03 B6 4E 4E 
39 01 00 00 00 00 02 D4 02 
39 01 00 00 00 00 02 BD 01 
39 01 00 00 00 00 02 B1 00

39 01 00 00 00 00 02 BD 00 
39 01 00 00 00 00 07 C9 13 00 12 10 B1 10
05 01 00 00 C8 00 02 11 00 
39 01 00 00 00 00 0D B2 00 80 64 0E 0A 2F 00 00 00 00 C0 18
05 01 00 00 0A 00 02 29 00 
39 01 00 00 00 00 02 51 00 
39 01 00 00 00 00 02 53 2C 
39 01 00 00 00 00 02 55 01 ];
		qcom,mdss-dsi-off-command = [05 01 00 00 14 00 02 28 00
05 01 00 00 78 00 02 10 00];
		qcom,mdss-dsi-on-command-state = "dsi_lp_mode";
		qcom,mdss-dsi-off-command-state = "dsi_hs_mode";
		qcom,mdss-dsi-h-sync-pulse = <1>;
		qcom,mdss-dsi-traffic-mode = "burst_mode";
		qcom,mdss-dsi-bllp-eof-power-mode;
		qcom,mdss-dsi-bllp-power-mode;
		qcom,mdss-dsi-lane-0-state;
		qcom,mdss-dsi-lane-1-state;
		qcom,mdss-dsi-lane-2-state;
		qcom,mdss-dsi-lane-3-state;
		qcom,mdss-dsi-panel-timings = [87 1C 12 00 42 44 18 20 17 03 04 00];
		qcom,mdss-dsi-t-clk-post = <0x04>;
		qcom,mdss-dsi-t-clk-pre = <0x1B>;
		qcom,mdss-dsi-bl-min-level = <1>;
		qcom,mdss-dsi-bl-max-level = <238>;
		qcom,mdss-dsi-dma-trigger = "trigger_sw";
		qcom,mdss-dsi-mdp-trigger = "none";
		qcom,mdss-dsi-bl-pmic-control-type = "bl_ctrl_dcs";
		qcom,mdss-dsi-reset-sequence = <1 20>, <0 20>, <1 60>;
        qcom,mdss-dsi-lp11-init;
		qcom,mdss-pan-physical-width-dimension = <64>;
		qcom,mdss-pan-physical-height-dimension = <115>;
	};
};
