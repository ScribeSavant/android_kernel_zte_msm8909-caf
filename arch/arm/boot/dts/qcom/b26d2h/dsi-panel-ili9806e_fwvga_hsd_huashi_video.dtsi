/* Copyright (c) 2014-2015, The Linux Foundation. All rights reserved.
 *
 * This program is free software; you can redistribute it and/or modify
 * it under the terms of the GNU General Public License version 2 and
 * only version 2 as published by the Free Software Foundation.
 *
 * This program is distributed in the hope that it will be useful,
 * but WITHOUT ANY WARRANTY; without even the implied warranty of
 * MERCHANTABILITY or FITNESS FOR A PARTICULAR PURPOSE.  See the
 * GNU General Public License for more details.
 */

/*---------------------------------------------------------------------------
 * This file is autogenerated file using gcdb parser. Please do not edit it.
 * Update input XML file to add a new entry or update variable in this file
 * VERSION = "1.0"
 *---------------------------------------------------------------------------*/
&mdss_mdp {
	dsi_ili9806e_fwvga_hsd_huashi_video: qcom,mdss_dsi_ili9806e_fwvga_hsd_huashi_video {
		qcom,mdss-dsi-panel-name = "ILI9806E fwvga hsd huashi video mode dsi panel";
		qcom,mdss-dsi-panel-controller = <&mdss_dsi0>;
		qcom,mdss-dsi-panel-type = "dsi_video_mode";
		qcom,mdss-dsi-panel-destination = "display_1";
		qcom,mdss-dsi-panel-framerate = <60>;
		qcom,mdss-dsi-virtual-channel-id = <0>;
		qcom,mdss-dsi-stream = <0>;
		qcom,mdss-dsi-panel-width = <480>;
		qcom,mdss-dsi-panel-height = <854>;
		qcom,mdss-dsi-h-front-porch = <80>;
		qcom,mdss-dsi-h-back-porch = <100>;
		qcom,mdss-dsi-h-pulse-width = <10>;
		qcom,mdss-dsi-h-sync-skew = <0>;
		qcom,mdss-dsi-v-back-porch = <16>;
		qcom,mdss-dsi-v-front-porch = <20>;
		qcom,mdss-dsi-v-pulse-width = <4>;
		qcom,mdss-dsi-h-left-border = <0>;
		qcom,mdss-dsi-h-right-border = <0>;
		qcom,mdss-dsi-v-top-border = <0>;
		qcom,mdss-dsi-v-bottom-border = <0>;
		qcom,mdss-dsi-bpp = <24>;
		qcom,mdss-dsi-underflow-color = <0xff>;
		qcom,mdss-dsi-border-color = <0>;
		qcom,mdss-dsi-on-command = [29 01 00 00 00 00 06 ff ff 98 06 04 01 29 01 00 00 00 00 02 08 10 29 01 00 00 00 00 02 21 01 29 01 00 00 00 00 02 30 01 29 01 00 00 00 00 02 31 00 29 01 00 00 00 00 02 40 15 29 01 00 00 00 00 02 41 33 29 01 00 00 00 00 02 42 03 29 01 00 00 00 00 02 43 09 29 01 00 00 00 00 02 44 07 29 01 00 00 00 00 02 50 88 29 01 00 00 00 00 02 51 88 29 01 00 00 00 00 02 52 00 29 01 00 00 00 00 02 53 5b 29 01 00 00 00 00 02 55 49 29 01 00 00 00 00 02 60 07 29 01 00 00 00 00 02 61 00 29 01 00 00 00 00 02 62 08 29 01 00 00 00 00 02 63 00 29 01 00 00 00 00 02 a0 00 29 01 00 00 00 00 02 a1 0b 29 01 00 00 00 00 02 a2 12 29 01 00 00 00 00 02 a3 0d 29 01 00 00 00 00 02 a4 04 29 01 00 00 00 00 02 a5 09 29 01 00 00 00 00 02 a6 06 29 01 00 00 00 00 02 a7 03 29 01 00 00 00 00 02 a8 09 29 01 00 00 00 00 02 a9 0c 29 01 00 00 00 00 02 aa 14 29 01 00 00 00 00 02 ab 09 29 01 00 00 00 00 02 ac 11 29 01 00 00 00 00 02 ad 17 29 01 00 00 00 00 02 ae 0d 29 01 00 00 00 00 02 af 00 29 01 00 00 00 00 02 c0 00 29 01 00 00 00 00 02 c1 0c 29 01 00 00 00 00 02 c2 12 29 01 00 00 00 00 02 c3 0d 29 01 00 00 00 00 02 c4 08 29 01 00 00 00 00 02 c5 08 29 01 00 00 00 00 02 c6 06 29 01 00 00 00 00 02 c7 04 29 01 00 00 00 00 02 c8 08 29 01 00 00 00 00 02 c9 0c 29 01 00 00 00 00 02 ca 12 29 01 00 00 00 00 02 cb 06 29 01 00 00 00 00 02 cc 0c 29 01 00 00 00 00 02 cd 18 29 01 00 00 00 00 02 ce 0d 29 01 00 00 00 00 02 cf 00 29 01 00 00 00 00 06 ff ff 98 06 04 06 29 01 00 00 00 00 02 00 21 29 01 00 00 00 00 02 01 09 29 01 00 00 00 00 02 02 00 29 01 00 00 00 00 02 03 00 29 01 00 00 00 00 02 04 01 29 01 00 00 00 00 02 05 01 29 01 00 00 00 00 02 06 80 29 01 00 00 00 00 02 07 05 29 01 00 00 00 00 02 08 02 29 01 00 00 00 00 02 09 80 29 01 00 00 00 00 02 0a 00 29 01 00 00 00 00 02 0b 00 29 01 00 00 00 00 02 0c 0a 29 01 00 00 00 00 02 0d 0a 29 01 00 00 00 00 02 0e 00 29 01 00 00 00 00 02 0f 00 29 01 00 00 00 00 02 10 e0 29 01 00 00 00 00 02 11 e4 29 01 00 00 00 00 02 12 04 29 01 00 00 00 00 02 13 00 29 01 00 00 00 00 02 14 00 29 01 00 00 00 00 02 15 c0 29 01 00 00 00 00 02 16 08 29 01 00 00 00 00 02 17 00 29 01 00 00 00 00 02 18 00 29 01 00 00 00 00 02 19 00 29 01 00 00 00 00 02 1a 00 29 01 00 00 00 00 02 1b 00 29 01 00 00 00 00 02 1c 00 29 01 00 00 00 00 02 1d 00 29 01 00 00 00 00 02 20 01 29 01 00 00 00 00 02 21 23 29 01 00 00 00 00 02 22 45 29 01 00 00 00 00 02 23 67 29 01 00 00 00 00 02 24 01 29 01 00 00 00 00 02 25 23 29 01 00 00 00 00 02 26 45 29 01 00 00 00 00 02 27 67 29 01 00 00 00 00 02 30 01 29 01 00 00 00 00 02 31 11 29 01 00 00 00 00 02 32 00 29 01 00 00 00 00 02 33 ee 29 01 00 00 00 00 02 34 ff 29 01 00 00 00 00 02 35 bb 29 01 00 00 00 00 02 36 ca 29 01 00 00 00 00 02 37 dd 29 01 00 00 00 00 02 38 ac 29 01 00 00 00 00 02 39 76 29 01 00 00 00 00 02 3a 67 29 01 00 00 00 00 02 3b 22 29 01 00 00 00 00 02 3c 22 29 01 00 00 00 00 02 3d 22 29 01 00 00 00 00 02 3e 22 29 01 00 00 00 00 02 3f 22 29 01 00 00 00 00 02 40 22 29 01 00 00 00 00 06 ff ff 98 06 04 07 29 01 00 00 00 00 02 b3 10 29 01 00 00 00 00 02 17 22 29 01 00 00 00 00 02 02 77 29 01 00 00 00 00 02 26 b2 29 01 00 00 00 00 02 e1 79 29 01 00 00 00 00 02 06 11 29 01 00 00 00 00 06 ff ff 98 06 04 00 29 01 00 00 00 00 02 36 00 05 01 00 00 78 00 02 11 00 05 01 00 00 32 00 02 29 00];
		qcom,mdss-dsi-off-command = [05 01 00 00 32 00 02 28 00 05 01 00 00 78 00 02 10 00];
		qcom,mdss-dsi-on-command-state = "dsi_lp_mode";
		qcom,mdss-dsi-off-command-state = "dsi_lp_mode";
		qcom,mdss-dsi-h-sync-pulse = <1>;
		qcom,mdss-dsi-traffic-mode = "non_burst_sync_pulse";
		qcom,mdss-dsi-lane-map = "lane_map_0123";
		qcom,mdss-dsi-bllp-eof-power-mode;
		qcom,mdss-dsi-bllp-power-mode;
		qcom,mdss-dsi-lane-0-state;
		qcom,mdss-dsi-lane-1-state;
		qcom,mdss-dsi-panel-timings = <0x73191000 0x3c46141c 0x1c030400>;
		qcom,mdss-dsi-t-clk-post = <0x4>;
		qcom,mdss-dsi-t-clk-pre = <0x1b>;
		qcom,mdss-dsi-bl-min-level = <1>;
		qcom,mdss-dsi-bl-max-level = <255>;
		qcom,mdss-dsi-dma-trigger = "trigger_sw";
		qcom,cont-splash-enabled;
		qcom,mdss-dsi-bl-pmic-control-type = "bl_ctrl_pwm";
		qcom,mdss-dsi-bl-pmic-pwm-frequency = <100>;
		qcom,mdss-dsi-bl-pmic-bank-select = <0>;
		qcom,mdss-dsi-pwm-gpio = <&pm8909_mpps 2 0>;
		qcom,mdss-dsi-mdp-trigger = "none";
		qcom,mdss-dsi-reset-sequence = <0x1 0x14 0x0 0x14 0x1 0x14>;
		qcom,mdss-dsi-lp11-init;
		qcom,mdss-dsi-init-delay-us = <50000>;
	};
};