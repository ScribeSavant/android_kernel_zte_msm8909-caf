/* Copyright (c) 2014-2015, The Linux Foundation. All rights reserved.
 *
 * This program is free software; you can redistribute it and/or modify
 * it under the terms of the GNU General Public License version 2 and
 * only version 2 as published by the Free Software Foundation.
 *
 * This program is distributed in the hope that it will be useful,
 * but WITHOUT ANY WARRANTY; without even the implied warranty of
 * MERCHANTABILITY or FITNESS FOR A PARTICULAR PURPOSE.  See the
 * GNU General Public License for more details.
 */

/*---------------------------------------------------------------------------
 * This file is autogenerated file using gcdb parser. Please do not edit it.
 * Update input XML file to add a new entry or update variable in this file
 * VERSION = "1.0"
 *---------------------------------------------------------------------------*/
&mdss_mdp {
	dsi_ili9881c_720p_hsd_5in_hlt_video: qcom,mdss_dsi_ili9881c_720p_hsd_5in_hlt_video {
		qcom,mdss-dsi-panel-name = "ili9881c 720p hsd helitai video mode dsi panel";
		qcom,mdss-dsi-panel-controller = <&mdss_dsi0>;
		qcom,mdss-dsi-panel-type = "dsi_video_mode";
		qcom,mdss-dsi-panel-destination = "display_1";
		qcom,mdss-dsi-panel-framerate = <60>;
		qcom,mdss-dsi-virtual-channel-id = <0>;
		qcom,mdss-dsi-stream = <0>;
		qcom,mdss-dsi-panel-width = <720>;
		qcom,mdss-dsi-panel-height = <1280>;
		qcom,mdss-dsi-h-front-porch = <80>;
		qcom,mdss-dsi-h-back-porch = <100>;
		qcom,mdss-dsi-h-pulse-width = <10>;
		qcom,mdss-dsi-h-sync-skew = <0>;
		qcom,mdss-dsi-v-back-porch = <18>;
		qcom,mdss-dsi-v-front-porch = <20>;
		qcom,mdss-dsi-v-pulse-width = <8>;
		qcom,mdss-dsi-h-left-border = <0>;
		qcom,mdss-dsi-h-right-border = <0>;
		qcom,mdss-dsi-v-top-border = <0>;
		qcom,mdss-dsi-v-bottom-border = <0>;
		qcom,mdss-dsi-bpp = <24>;
		qcom,mdss-dsi-underflow-color = <0xff>;
		qcom,mdss-dsi-border-color = <0>;
		qcom,mdss-dsi-h-sync-pulse = <0>;
		qcom,mdss-dsi-on-command = <0x29010000 0x4ff 0x98810329 0x1000000 0x20100 0x29010000 0x202 0x290100 0x2 0x3732901 0x0 0x2040029 0x1000000 0x20500 0x29010000 0x206 0xa290100 0x2 0x7002901 0x0 0x2080029 0x1000000 0x20901 0x29010000 0x20a 0x290100 0x2 0xb002901 0x0 0x20c0129 0x1000000 0x20d00 0x29010000 0x20e 0x290100 0x2 0xf1d2901 0x0 0x2101d29 0x1000000 0x21100 0x29010000 0x212 0x290100 0x2 0x13002901 0x0 0x2140029 0x1000000 0x21500 0x29010000 0x216 0x290100 0x2 0x17002901 0x0 0x2180029 0x1000000 0x21900 0x29010000 0x21a 0x290100 0x2 0x1b002901 0x0 0x21c0029 0x1000000 0x21d00 0x29010000 0x21e 0x40290100 0x2 0x1f802901 0x0 0x2200629 0x1000000 0x22102 0x29010000 0x222 0x290100 0x2 0x23002901 0x0 0x2240029 0x1000000 0x22500 0x29010000 0x226 0x290100 0x2 0x27002901 0x0 0x2283329 0x1000000 0x22903 0x29010000 0x22a 0x290100 0x2 0x2b002901 0x0 0x22c0029 0x1000000 0x22d00 0x29010000 0x22e 0x290100 0x2 0x2f002901 0x0 0x2300029 0x1000000 0x23100 0x29010000 0x232 0x290100 0x2 0x33002901 0x0 0x2340429 0x1000000 0x23500 0x29010000 0x236 0x290100 0x2 0x37002901 0x0 0x2383c29 0x1000000 0x23900 0x29010000 0x23a 0x40290100 0x2 0x3b402901 0x0 0x23c0029 0x1000000 0x23d00 0x29010000 0x23e 0x290100 0x2 0x3f002901 0x0 0x2400029 0x1000000 0x24100 0x29010000 0x242 0x290100 0x2 0x43002901 0x0 0x2440029 0x1000000 0x25001 0x29010000 0x251 0x23290100 0x2 0x52452901 0x0 0x2536729 0x1000000 0x25489 0x29010000 0x255 0xab290100 0x2 0x56012901 0x0 0x2572329 0x1000000 0x25845 0x29010000 0x259 0x67290100 0x2 0x5a892901 0x0 0x25bab29 0x1000000 0x25ccd 0x29010000 0x25d 0xef290100 0x2 0x5e112901 0x0 0x25f0129 0x1000000 0x26000 0x29010000 0x261 0x15290100 0x2 0x62142901 0x0 0x2630e29 0x1000000 0x2640f 0x29010000 0x265 0xc290100 0x2 0x660d2901 0x0 0x2670629 0x1000000 0x26802 0x29010000 0x269 0x7290100 0x2 0x6a022901 0x0 0x26b0229 0x1000000 0x26c02 0x29010000 0x26d 0x2290100 0x2 0x6e022901 0x0 0x26f0229 0x1000000 0x27002 0x29010000 0x271 0x2290100 0x2 0x72022901 0x0 0x2730229 0x1000000 0x27402 0x29010000 0x275 0x1290100 0x2 0x76002901 0x0 0x2771429 0x1000000 0x27815 0x29010000 0x279 0xe290100 0x2 0x7a0f2901 0x0 0x27b0c29 0x1000000 0x27c0d 0x29010000 0x27d 0x6290100 0x2 0x7e022901 0x0 0x27f0729 0x1000000 0x28002 0x29010000 0x281 0x2290100 0x2 0x82022901 0x0 0x2830229 0x1000000 0x28402 0x29010000 0x285 0x2290100 0x2 0x86022901 0x0 0x2870229 0x1000000 0x28802 0x29010000 0x289 0x2290100 0x2 0x8a022901 0x0 0x4ff9881 0x4290100 0x2 0x6c152901 0x0 0x26e2a29 0x1000000 0x26f35 0x29010000 0x23a 0x94290100 0x2 0x8d152901 0x0 0x287ba29 0x1000000 0x22676 0x29010000 0x2b2 0xd1290100 0x2 0xb5062901 0x0 0x4ff9881 0x1290100 0x2 0x220a2901 0x0 0x2310029 0x1000000 0x25394 0x29010000 0x255 0xbf290100 0x2 0x509a2901 0x0 0x2519a29 0x1000000 0x26022 0x29010000 0x261 0x290100 0x2 0x62192901 0x0 0x2631029 0x1000000 0x2a008 0x29010000 0x2a1 0x17290100 0x2 0xa2182901 0x0 0x2a30e29 0x1000000 0x2a40f 0x29010000 0x2a5 0x1e290100 0x2 0xa6132901 0x0 0x2a71629 0x1000000 0x2a84c 0x29010000 0x2a9 0x1a290100 0x2 0xaa272901 0x0 0x2ab4229 0x1000000 0x2ac1c 0x29010000 0x2ad 0x1c290100 0x2 0xae512901 0x0 0x2af2629 0x1000000 0x2b02a 0x29010000 0x2b1 0x3f290100 0x2 0xb24e2901 0x0 0x2b33f29 0x1000000 0x2c008 0x29010000 0x2c1 0x9290100 0x2 0xc2172901 0x0 0x2c30e29 0x1000000 0x2c40f 0x29010000 0x2c5 0x1e290100 0x2 0xc6132901 0x0 0x2c71729 0x1000000 0x2c845 0x29010000 0x2c9 0x1a290100 0x2 0xca272901 0x0 0x2cb4229 0x1000000 0x2cc1c 0x29010000 0x2cd 0x1c290100 0x2 0xce512901 0x0 0x2cf2629 0x1000000 0x2d02a 0x29010000 0x2d1 0x3f290100 0x2 0xd24e2901 0x0 0x2d33f29 0x1000000 0x4ff98 0x81000501 0x7800 0x2110005 0x1000032 0x22900>;
		qcom,mdss-dsi-off-command = [05 01 00 00 14 00 02 28 00 05 01 00 00 78 00 02 10 00];
		qcom,mdss-dsi-on-command-state = "dsi_lp_mode";
		qcom,mdss-dsi-off-command-state = "dsi_lp_mode";
		qcom,mdss-dsi-panel-status-command = [06 01 00 01 05 00 02 0a 08];
		qcom,mdss-dsi-panel-status-command-state = "dsi_lp_mode";
		qcom,mdss-dsi-panel-status-check-mode = "reg_read";
		qcom,mdss-dsi-panel-status-valid-params = <1>;
		qcom,mdss-dsi-panel-status-value = <156>;
		qcom,mdss-dsi-panel-status-read-length = <1>;
		qcom,esd-check-enabled;
		qcom,mdss-dsi-traffic-mode = "burst_mode";
		qcom,mdss-dsi-bllp-eof-power-mode;
		qcom,mdss-dsi-bllp-power-mode;
		qcom,mdss-dsi-lane-0-state;
		qcom,mdss-dsi-lane-1-state;
		qcom,mdss-dsi-lane-2-state;
		qcom,mdss-dsi-lane-3-state;
		qcom,mdss-dsi-panel-timings = <0x7b1a1000 0x3c40141c 0x15030400>;
		qcom,mdss-dsi-t-clk-post = <0xa>;
		qcom,mdss-dsi-t-clk-pre = <0x26>;
		qcom,mdss-dsi-bl-min-level = <1>;
		qcom,mdss-dsi-bl-max-level = <255>;
		qcom,mdss-dsi-dma-trigger = "trigger_sw";
		qcom,cont-splash-enabled;
		qcom,mdss-dsi-mdp-trigger = "none";
		qcom,mdss-dsi-bl-pmic-pwm-frequency = <100>;
		qcom,mdss-dsi-bl-pmic-bank-select = <0>;
		qcom,mdss-dsi-pwm-gpio = <&pm8909_mpps 2 0>;
		qcom,mdss-dsi-bl-pmic-control-type = "bl_ctrl_pwm";
		qcom,mdss-dsi-reset-sequence = <0x1 0x14 0x0 0x2 0x1 0x14>;
		qcom,mdss-dsi-lp11-init;
		qcom,mdss-dsi-init-delay-us = <50>;
	};
};