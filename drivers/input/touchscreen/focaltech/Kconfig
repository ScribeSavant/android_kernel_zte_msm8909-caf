## drivers/input/touchscreen/focaltech/Kconfig
```kconfig
#
# Focaltech FT6x36 touchscreen driver configuration
#
menuconfig TOUCHSCREEN_FOCALTECH
	bool "Focaltech ft6x06 touchscreen"
	default y
	help
	  Say Y here if you have a focaltech ft6x06 touchscreen connected
	  to your system.

	  If unsure, say N.
if TOUCHSCREEN_FOCALTECH

config TOUCHSCREEN_FTS
	tristate "Focaltech ft6x36 core driver module"
	default y
	help
	  Say Y here to enable basic touch reporting functionalities.

	  If unsure, say N.

	  To compile this driver as a module, choose M here: the
	  module will be called synaptics_dsx_core.

config TOUCHSCREEN_FTS_EX_FUN
	tristate "Focaltech ft6x36 core driver module"
	default y
	help
	  Say Y here to enable basic touch reporting functionalities.

	  If unsure, say N.

	  To compile this driver as a module, choose M here: the
	  module will be called synaptics_dsx_core.

config TOUCHSCREEN_FTS_CTL
	tristate "Focaltech ft6x36 core driver module"
	default y
	help
	  Say Y here to enable basic touch reporting functionalities.

	  If unsure, say N.

	  To compile this driver as a module, choose M here: the
	  module will be called synaptics_dsx_core.

config TOUCHSCREEN_FTS_FLASH
        tristate "Focaltech ft6x36 core driver module"
	default y
	help
	  Say Y here to enable basic touch reporting functionalities.

	  If unsure, say N.

	  To compile this driver as a module, choose M here: the
	  module will be called synaptics_dsx_core.

config TOUCHSCREEN_FTS_GESTURE
    tristate "Focaltech ft6x36 core driver module"
	default y
	help
	  Say Y here to enable basic touch reporting functionalities.

	  If unsure, say N.

	  To compile this driver as a module, choose M here: the
	  module will be called synaptics_dsx_core.
endif
```

## drivers/input/touchscreen/msg22xx_g151/Kconfig
```kconfig
#
# Mstar msg2xxx touchscreen driver configuration
#
menuconfig TOUCHSCREEN_MSTAR_G151
	bool "Mstar msg2xxx touchscreen"
	default y
	help
	  Say Y here if you have a Mstar msg2xxx touchscreen connected
	  to your system.

	  If unsure, say N.
if TOUCHSCREEN_MSTAR_G151

config TOUCHSCREEN_MSTAR_DRV_COMMON_MSG2xxx
	tristate "Mstar msg2xxx core driver module"
	help
	  Say Y here to enable basic touch reporting functionalities.

	  If unsure, say N.

	  To compile this driver as a module, choose M here: the
	  module will be called synaptics_dsx_core.

config TOUCHSCREEN_MSTAR_DRV_IC_FW_PORTING_LAYER_MSG2xxx
	tristate "Mstar msg2xxx core driver module"
	help
	  Say Y here to enable basic touch reporting functionalities.

	  If unsure, say N.

	  To compile this driver as a module, choose M here: the
	  module will be called synaptics_dsx_core.

config TOUCHSCREEN_MSTAR_DRV_QCOM_MSG2xxx
	tristate "Mstar msg2xxx core driver module"
	help
	  Say Y here to enable basic touch reporting functionalities.

	  If unsure, say N.

	  To compile this driver as a module, choose M here: the
	  module will be called synaptics_dsx_core.

config TOUCHSCREEN_MSTAR_DRV_SELF_FW_CONTROL_MSG2xxx
	tristate "Mstar msg2xxx core driver module"
	help
	  Say Y here to enable basic touch reporting functionalities.

	  If unsure, say N.

	  To compile this driver as a module, choose M here: the
	  module will be called synaptics_dsx_core.

config TOUCHSCREEN_MSTAR_DRV_SELF_MP_TEST_MSG2xxx
	tristate "Mstar msg2xxx core driver module"
	help
	  Say Y here to enable basic touch reporting functionalities.

	  If unsure, say N.

	  To compile this driver as a module, choose M here: the
	  module will be called synaptics_dsx_core.

config TOUCHSCREEN_MSTAR_DRV_UTILITY_ADAPTION_MSG2xxx
	tristate "Mstar msg2xxx core driver module"
	help
	  Say Y here to enable basic touch reporting functionalities.

	  If unsure, say N.

	  To compile this driver as a module, choose M here: the
	  module will be called synaptics_dsx_core.

config TOUCHSCREEN_MSTAR_DRV_PLATFORM_INTERFACE_MSG2xxx
	tristate "Mstar msg2xxx core driver module"
	help
	  Say Y here to enable basic touch reporting functionalities.

	  If unsure, say N.

	  To compile this driver as a module, choose M here: the
	  module will be called synaptics_dsx_core.

config TOUCHSCREEN_MSTAR_DRV_PLATFORM_PORTING_LAYER_MSG2xxx
	tristate "Mstar msg2xxx core driver module"
	help
	  Say Y here to enable basic touch reporting functionalities.

	  If unsure, say N.

	  To compile this driver as a module, choose M here: the
	  module will be called synaptics_dsx_core.

config TOUCHSCREEN_MSTAR_DRV_MAIN_MSG2xxx
	tristate "Mstar msg2xxx core driver module"
	help
	  Say Y here to enable basic touch reporting functionalities.

	  If unsure, say N.

	  To compile this driver as a module, choose M here: the
	  module will be called synaptics_dsx_core.

config TOUCHSCREEN_MSTAR_DRV_JNI_INTERFACE_MSG2xxx
    tristate "Mstar msg2xxx core driver module"
	help
	  Say Y here to enable basic touch reporting functionalities.

	  If unsure, say N.

	  To compile this driver as a module, choose M here: the
	  module will be called synaptics_dsx_core.
endif
```

## drivers/input/touchscreen/mstar_3.3/Kconfig
```kconfig
#
# Mstar msg2238 touchscreen driver configuration
#
menuconfig TOUCHSCREEN_MSTAR_V33
	bool "Mstar msg2238 touchscreen"
	help
	  Say Y here if you have a Mstar msg22xx touchscreen connected
	  to your system.

	  If unsure, say N.
```

## drivers/platform/haier/Kconfig
```kconfig
# Haier configuration options

config MACH_HAIER
	bool "Haier device"
	depends on ARCH_MSM
	help
	  Support for Haier products

config MACH_HAIER_MSM8916
	bool "Haier MSM8916"
	depends on ARCH_MSM8916
	select MACH_HAIER
	help
	  Support for MSM8916 Haier variants
	  
config MACH_HAIER_MSM8909
	bool "Haier MSM8909"
	depends on ARCH_MSM8909
	select MACH_HAIER
	help
	  Support for MSM8909 Haier variants

menu "Haier board selection"

config MACH_RENDANG
	bool "Rendang board"
	select MACH_HAIER_MSM8916
	help
	  Support for Haier Rendang variant

config MACH_HY_A16C3H
	bool "A16C3H board"
	select MACH_HAIER_MSM8909
	help
	  Support for Haier A16C3H variant

config MACH_B26D2H
	bool "B26D2H board"
	select MACH_HAIER_MSM8909
	help
	  Support for Haier B26D2H variant

endmenu
```

## drivers/platform/hisense/Kconfig
```kconfig
# Hisense configuration options

config MACH_HISENSE
	bool "Hisense device"
	depends on ARCH_MSM
	help
	  Support for Hisense products

config MACH_HISENSE_MSM8916
	bool "Hisense MSM8916"
	depends on ARCH_MSM8916
	select MACH_HISENSE
	help
	  Support for MSM8916 Hisense variants
	  
config MACH_HISENSE_MSM8909
	bool "Hisense MSM8909"
	depends on ARCH_MSM8909
	select MACH_HISENSE
	help
	  Support for MSM8909 Hisense variants

menu "Hisense board selection"

config MACH_B16C2G
	bool "B16C2G board"
	select MACH_HISENSE_MSM8909
	help
	  Support for Hisense B16C2G variant

endmenu
```
